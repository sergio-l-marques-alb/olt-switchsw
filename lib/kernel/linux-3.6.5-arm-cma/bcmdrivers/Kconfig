## lib/kernel/linux-3.6.5-arm-cma/bcmdrivers/Kconfig
```kconfig
menu "Broadcom iProc Drivers"
	depends on ARCH_IPROC

#source "bcmdrivers/regmod/Kconfig"
source "bcmdrivers/timer/Kconfig"
source "bcmdrivers/otp/Kconfig"
source "bcmdrivers/rng/Kconfig"
source "bcmdrivers/rng200/Kconfig"
source "bcmdrivers/mdio/Kconfig"
source "bcmdrivers/gsio_spi/Kconfig"
source "bcmdrivers/sd/Kconfig"
source "bcmdrivers/dma/Kconfig"
source "bcmdrivers/gpio/Kconfig"
source "bcmdrivers/qspi/Kconfig"
source "bcmdrivers/nand/Kconfig"
source "bcmdrivers/kdrivers/nor/Kconfig"
source "bcmdrivers/pwm/Kconfig"
source "bcmdrivers/wdt/Kconfig"
source "bcmdrivers/usb2h/Kconfig"
source "bcmdrivers/usb3h/Kconfig"
source "bcmdrivers/usbd/Kconfig"
source "bcmdrivers/pcie/Kconfig"
source "bcmdrivers/gmac/et/Kconfig"
source "bcmdrivers/gmac/hnd/Kconfig"
source "bcmdrivers/sound/Kconfig"
source "bcmdrivers/smbus/Kconfig"
source "bcmdrivers/sra/Kconfig"
source "bcmdrivers/broadcom/char/fa/Kconfig"
source "bcmdrivers/tdm/Kconfig"
source "bcmdrivers/fa2/Kconfig"
source "bcmdrivers/crypto/Kconfig"
source "bcmdrivers/xor/Kconfig"
source "bcmdrivers/kdrivers/pppoe/Kconfig"
source "bcmdrivers/pmu/Kconfig"

config BCM_IPROC_CA9_PREFETCH
	tristate "CortexA9 cache auto-prefetching support"
	depends on ARCH_IPROC
	default n
	help
	  Enable iProc CortexA9 L1/L2 cache auto-prefetching support
	
	  If unsure, say N.

config BCM_BARRIER_PERFORMANCE
	bool "Linux memory barrier performance improvement"
	depends on ARCH_IPROC
	default n
	help
	  Enable linux memory barrier performance improvements
	
	  If unsure, say N.

config BCM_MEM_OPTIMIZATION
	bool "ARM Memory library optimization"
	depends on ARCH_IPROC
	default n
	help
	  Enable ARM memory library optimization
	
	  If unsure, say N.

### pae
source "bcmdrivers/pae/paemsg/Kconfig"
source "bcmdrivers/pae/ipsec/Kconfig"

### kdrivers
##  kdrivers/nor integrated at ../kernel/linux-3.6.5/drivers/mtd/Makefile
##  CFI driver required to be integrated before the bsp file builds

### hook for gpl driver master file
source "bcmgpldrivers/Kconfig"
### hook for partner driver master file
#source "bcmpartnerdrivers/Kconfig"
endmenu
```

## lib/kernel/linux-3.6.5-arm-cma/bcmdrivers/crypto/Kconfig
```kconfig
config IPROC_CRYPTO
	tristate "NS+ symmetric crypto/hash acceleration support"
	depends on ARCH_IPROC && MACH_NSP && IPROC_FA2
	default n
	help
	  NS+ symmetric crypto acceleration support
	  This driver provides kernel support for Northstar+ crypto acceleration
	
	  If unsure, say N.
```

## lib/kernel/linux-3.6.5-arm-cma/bcmdrivers/pae/ipsec/Kconfig
```kconfig
config IPROC_PAE_IPSEC
	tristate "PAE IPSEC support"
	select INET_ESP
	select INET_AH
	depends on ARCH_IPROC && IPROC_PAE
	default n
	help
	  PAE IPSEC support 
	  This driver provides kernel-side support for a PAE IPSEC
	
	  If unsure, say N.
```

## lib/kernel/linux-3.6.5-arm-cma/bcmdrivers/rng200/Kconfig
```kconfig
config IPROC_RNG200
	tristate "iProc RNG200 support"
	select HW_RANDOM
	depends on ARCH_IPROC && MACH_IPROC_P7
	default n
	help
	  iProc RNG200 support 
	  This driver provides kernel-side support for a iProc Random
	  Number Generator RNG200.
	
	  If unsure, say N.
```

## lib/kernel/linux-3.6.5-arm-cma/bcmdrivers/sound/Kconfig
```kconfig
# Helper to resolve issues with configs that have SPI enabled but I2C
# modular, meaning we can't build the codec driver in with I2C support.
# We use an ordered list of conditional defaults to pick the appropriate
# setting - SPI can't be modular so that case doesn't need to be covered.

config IPROC_SND
	tristate "Sound/I2S support"
	depends on ARCH_IPROC && IPROC_GSIO_SPI
	default n
	help
	  Sound I2S support 
	  This driver provides kernel-side support for a sound and I2S
	  Number Generator.
	
	  If unsure, say N.
```

## lib/kernel/linux-3.6.5-arm-cma/bcmdrivers/tdm/Kconfig
```kconfig
# Helper to resolve issues with configs that have SPI enabled but I2C
# modular, meaning we can't build the codec driver in with I2C support.
# We use an ordered list of conditional defaults to pick the appropriate
# setting - SPI can't be modular so that case doesn't need to be covered.

config IPROC_TDM
	tristate "Iproc TDM support"
	depends on ARCH_IPROC && IPROC_GSIO_SPI
	default n
	help
	  Iproc TDM support 
	  This driver provides kernel-side support for iProc TDM.
	
	  If unsure, say N.
```

## lib/kernel/linux-3.6.5-arm-cma/bcmdrivers/xor/Kconfig
```kconfig
config IPROC_XOR
	tristate "NS+ XOR offload support"
	depends on ARCH_IPROC && MACH_NSP
    select ASYNC_TX_ENABLE_CHANNEL_SWITCH
    default n
	help
	  NS+ XOR offload support
	  This driver provides kernel support for XOR offload to the PAE through a DMA-like interface
	
	  If unsure, say N.
```

## lib/kernel/linux-3.6.5-arm/bcmdrivers/pae/paemsg/Kconfig
```kconfig
config IPROC_PAE
	tristate "PAE support"
	depends on ARCH_IPROC && MACH_NSP
	default n
	help
	  PAE support 
	  This driver provides support for the Programmable Accelerator Engine in the NorthstarPlus
	
	  If unsure, say N.
```

## lib/kernel/linux-3.6.5-arm/bcmgpldrivers/Kconfig
```kconfig
menu "Broadcom iProc GPL Drivers"
	depends on ARCH_IPROC

source "bcmgpldrivers/sound/codecs/wm8955/Kconfig"
source "bcmgpldrivers/sound/codecs/wm8750/Kconfig"
source "bcmgpldrivers/watchdog/Kconfig"

endmenu
```

## lib/kernel/linux-3.6.5-arm_old/arch/arm/mach-iproc/Kconfig
```kconfig
menu	"iProc SoC based Machine types"
	depends on MACH_IPROC

choice
	prompt "iProc SoC based board type"
	default MACH_IPROC_NS	

config MACH_CYGNUS
	bool "Cygnus bring-up board"
	help
	Support for the Broadcom Cygnus bring-up board.

config MACH_NS
	bool "Support Broadcom Northstar bring-up board"
	help
	  Support for the Broadcom Northstar bring-up board.

config MACH_HX4
	bool "Support Broadcom Helix4 bring-up board"
	help
	  Support for the Broadcom Helix4 bring-up board.

config MACH_HR2
	bool "Support Broadcom Hurricane2 bring-up board"
	help
	  Support for the Broadcom Hurricane2 bring-up board.

config MACH_NSP
	bool "Support Broadcom Northstar Plus bring-up board"
	help
	  Support for the Broadcom Northstar Plus bring-up board.

config MACH_KT2
	bool "Support Broadcom Katana2 bring-up board"
	help
	  Support for the Broadcom Katana2 bring-up board.

config MACH_GH
	bool "Support Broadcom Greyhound bring-up board"
	select MACH_IPROC_P7
	help
	  Support for the Broadcom Greyhound bring-up board.

endchoice

config MACH_IPROC_P7
	bool "Support iProc Profile 7 architecture"
	depends on MACH_GH
	help
	  Support for iProc Profile 7 architecture.

config MACH_IPROC_EMULATION
	bool "Support  iProc emulation"
	help
	  Support for the iProc emulation.

if MACH_CYGNUS

config MACH_CYGNUS_EMULATION
	bool "Is it Cygnus emulation ?"
	default y
	help
	Support for the Broadcom Cygnus emulation

if MACH_CYGNUS_EMULATION

config CYGNUS_EMULATION_RTL_VER
	string "specify RTL version"
	default "Cygnus RTL-5.1"
	help
	running rtl version used for emulation build

config CYGNUS_EMULATION_ARM_CLK
	int "Hz - iHost clk don't change"
	default 250000000
	help
	iHost clock in emulator

config CYGNUS_EMULATION_PCLK
	int "Hz - axi81 (pclk) in xls"
	default 62500000
	help
	pheripheral clock in emulator

config CYGNUS_EMULATION_SCLK
	int "Hz - sclk in xls"
	default 154380
	help
	uart clock in emulator

config CYGNUS_EMULATION_CLK_125
	int "Hz - axi41 clock in xls"
	default 154380
	help
	125Mhz equialent clock in emulator

endif #MACH_CYGNUS_EMULATION

endif #MACH_CYGNUS

endmenu
```

## lib/kernel/linux-3.6.5-kt2arm_LDK-3.4.7-RC4/bcmdrivers/usbd/Kconfig
```kconfig
config IPROC_USB2D
	tristate "USB 2.0 Device"
	select USB_GADGET_DUALSPEED
	depends on ARCH_IPROC && USB_GADGET && (MACH_HX4 || MACH_KT2)
	default n
	help
	  Add USB 2.0 Device support
	
	  If unsure, say N.
```

## linux-3.6.5-arm-cma/bcmdrivers/broadcom/char/fa/Kconfig
```kconfig
config IPROC_FA
	tristate "FA (CTF) support"
	select BCM_CTF
	depends on ARCH_IPROC && MACH_NS
	default n
	help
	  FA support 
	  This driver provides kernel-side support for a HW flow accelerator
	
	  If unsure, say N.
```

## linux-3.6.5-arm-cma/bcmdrivers/dma/Kconfig
```kconfig
config IPROC_DMA
	tristate "DMA support"
	depends on ARCH_IPROC
	select DMADEVICES
	select DMADEVICES_DEBUG
	select DMADEVICES_VDEBUG
	select DMA_ENGINE
	select PL330
	select DMAC_PL330
	select DMATEST
	default n
	help
	  DMA support for pl330
	
	  If unsure, say N.
```

## linux-3.6.5-arm-cma/bcmdrivers/fa2/Kconfig
```kconfig
menuconfig IPROC_FA2
	tristate "FA+ support"
	depends on ARCH_IPROC && MACH_NSP
	default n
	help
	  FA+ support 
	  This driver provides kernel support for Northstar+ Flow Accelerator
	
	  If unsure, say N.

if IPROC_FA2
config IPROC_FA2_CS_OFFLOAD
	bool "TCP, UDP checksum Offload"
	default n
	help
	  Enable TCP, UDP checksum offload function by selecting this option.
config IPROC_FA2_CS_OFFLOAD_SMALL_PKT_WA
	bool "Workaround for small TCP, UDP packets"
	depends on IPROC_FA2_CS_OFFLOAD
	default n
	help
	  Enables workaround for TCP, UDP pkt sizes <= 64 bytes. Hardware checksum
	  generation fails for small sized packets. This workaround is valid for
	  Northstar+ A0 only.
config IPROC_FA2_NAPT_BYPASS
	bool "FA2 NAPT Bypass"
	default n
	depends on IPROC_FA2_CS_OFFLOAD

endif # IPROC_FA2
```

## linux-3.6.5-arm-cma/bcmdrivers/kdrivers/pppoe/Kconfig
```kconfig
config IPROC_PPPOE_FA
	bool "Broadcom PPPOE offloading"
	depends on ARCH_IPROC
	depends on IPROC_FA2
	default n
	help
	  This enables PPPOE hardware offloading support.
	
	  If unsure, say N.
```

## linux-3.6.5-arm-cma/bcmdrivers/pcie/Kconfig
```kconfig
config IPROC_PCIE
	tristate "PCIE support"
	select PCI
	select PCI_DOMAINS
	depends on ARCH_IPROC
	default n
	help
	  Add PCIe support
	
	  If unsure, say N.
```

## linux-3.6.5-arm-cma/bcmdrivers/pwm/Kconfig
```kconfig
config IPROC_PWM
	tristate "PWM support"
	depends on ARCH_IPROC
	default n
	help
	  Add PWM support
	
	  If unsure, say N.
```

## linux-3.6.5-arm-cma/bcmdrivers/wdt/Kconfig
```kconfig
config IPROC_WDT
	tristate "Watchdog Timer support"
	select WATCHDOG
	depends on ARCH_IPROC && MACH_NS
	help
	  This selects a driver for the hardware watchdog on Broadcom
	  iProc chips.
```
